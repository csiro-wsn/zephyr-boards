## boards/arm/bleatag/Kconfig.board
```kconfig
# Copyright (c) 2021 CSIRO
# SPDX-License-Identifier: Apache-2.0

config BOARD_BLEATAG
	bool "BLEATAG"
	depends on SOC_SERIES_NRF52X && SOC_NRF52840_QIAA
```

## boards/arm/bleatag/Kconfig.defconfig
```kconfig
# Copyright (c) 2021 CSIRO

if BOARD_BLEATAG

config BOARD
	default "bleatag"

config BT_CTLR
	default BT

config SOC_FLASH_NRF_UICR
	default FLASH

endif # BOARD_BLEATAG
```

## boards/arm/bleatag/bleatag_defconfig
```kconfig
# Copyright (c) 2021 CSIRO
# SPDX-License-Identifier: Apache-2.0

CONFIG_SOC_SERIES_NRF52X=y
CONFIG_SOC_NRF52840_QIAA=y
CONFIG_BOARD_BLEATAG=y

# Enable MPU
CONFIG_ARM_MPU=y

# Enable hardware stack protection
CONFIG_HW_STACK_PROTECTION=y

# Enable GPIO
CONFIG_GPIO=y

# Enable CONSOLE
CONFIG_CONSOLE=y
CONFIG_UART_CONSOLE=y

# Enable uart driver
CONFIG_SERIAL=y

# Enable regulators
CONFIG_REGULATOR=y
CONFIG_REGULATOR_FIXED=y
```

## boards/arm/loci3/Kconfig.board
```kconfig
# Ceresat board configuration

# Copyright (c) 2016 Nordic Semiconductor ASA
# SPDX-License-Identifier: Apache-2.0

config BOARD_LOCI3
	bool "LOCI3"
	depends on SOC_SERIES_NRF52X && SOC_NRF52840_QIAA
```

## boards/arm/loci3/Kconfig.defconfig
```kconfig
# Ceresat board configuration

if BOARD_LOCI3

config BOARD
	default "loci3"

config BT_CTLR
	default BT

config SOC_FLASH_NRF_UICR
	default FLASH

endif # BOARD_LOCI3
```

## boards/arm/loci3/loci3_defconfig
```kconfig
# SPDX-License-Identifier: Apache-2.0

CONFIG_SOC_SERIES_NRF52X=y
CONFIG_SOC_NRF52840_QIAA=y
CONFIG_BOARD_LOCI3=y

# Enable MPU
CONFIG_ARM_MPU=y

# Enable hardware stack protection
CONFIG_HW_STACK_PROTECTION=y

# Enable GPIO
CONFIG_GPIO=y
CONFIG_NFCT_PINS_AS_GPIOS=y

# Enable CONSOLE
CONFIG_CONSOLE=y
CONFIG_UART_CONSOLE=y

# Enable uart driver
CONFIG_SERIAL=y
```
